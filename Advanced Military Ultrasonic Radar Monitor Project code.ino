#include <Servo.h> // As we've used Servo Motor so we've to include the Servo library or class
#include <LiquidCrystal.h> // As we've used LCD Display so we've to include the LiquidCrystal library or class
//lcd is an object_name of class LiquidCrystal
//for 8 bit mode: //LiquidCrystal lcd(rs,rw,en,d0,d1,d2,d3,d4,d5,d6,d7); //rs,rw,en are pins of LCD and 
//d0,d1,d2,d3,d4,d5,d6,d7 are pins of Arduino that are connected to D0,D1,D2,D3,D4,D5,D6,D7 data pins of LCD
//for 4 bit mode: //LiquidCrystal lcd(rs,rw,en,d4,d5,d6,d7); //rs,rw,en are pins of LCD and 
//d4,d5,d6,d7 are pins of Arduino that are connected to D4,D5,D6,D7 data pins of LCD
LiquidCrystal lcd(13,12,11,10,9,8); 
// Defines Tirg and Echo pins of the Ultrasonic Sensor
const int trigPin=3; //pin 3 is one Digital I/O pin of Arduino as trigpin goes to Digital I/O pin of Arduino
const int echoPin=2; //pin 2 is one Digital I/O pin of Arduino as echopin goes to Digital I/O pin of Arduino
// Variables for the duration and the distance
long duration;
int distance;
int buzzer=A5;
int led=A4;
Servo myServo; // Creates a servo object for controlling the servo motor
void setup() 
{
  // put your setup code here, to run once:
  lcd.begin(16,2); //Syntax: lcd.begin(the number of columns the LCD has,the number of rows the LCD has);
  pinMode(trigPin,OUTPUT); // Sets the trigPin as an Output
  pinMode(echoPin,INPUT); // Sets the echoPin as an Input
  pinMode(led,OUTPUT);
  pinMode(buzzer,OUTPUT); //
  digitalWrite(led,HIGH);
  digitalWrite(buzzer,LOW);
  Serial.begin(9600);
  lcd.clear(); //Syntax: lcd.clear(); //it clears the LCD screen and positions the cursor in the upper-left corner.lcd is a variable of type LiquidCrystal
  lcd.print("  Advance Radar"); //Syntax: lcd.print(value to be printed on LCD which may be char,byte,int,long or string);
  lcd.setCursor(0,1); //Syntax: lcd.setCursor(column,row); //first column is 0 and first row is 0 
  lcd.print("     System");
  delay(5000);
  myServo.attach(5); // Defines on which pin is the servo motor attached 
}

void loop() 
{
  // put your main code here, to run repeatedly:
  // rotates the servo motor from 15 to 165 degrees
  for (int i=15;i<=165;i++) 
  {
    myServo.write(i);
    // delay(30);
    distance=calculateDistance();// Calling calculateDistance() method for calculating the distance measured by the Ultrasonic sensor for each degree
    if(distance>100) 
   {
      distance=100;
    }
    Serial.print(i); // Sends the current degree into the Serial Port
    Serial.print(","); // Sends addition character right next to the previous value needed later in the Processing IDE for indexing
    Serial.print(distance); // Sends the distance value into the Serial Port
    Serial.print("."); // Sends addition character right next to the previous value needed later in the Processing IDE for indexing
    if (distance<40) 
    {
      digitalWrite(led,LOW);
      digitalWrite(buzzer,HIGH);
    }
    else 
    {
      digitalWrite(led,HIGH);
      digitalWrite(buzzer,LOW);
    }
    lcd.clear();
    lcd.print("Angle= ");
    lcd.print(i);
    lcd.print("\337"); 
    lcd.setCursor(0,1);
    lcd.print("Distance= ");
    lcd.print(distance);
    lcd.print("/cm") ;
    delay(200);
  }
  // Repeats the previous lines from 165 to 15 degrees
  for (int i=165;i>15;i--) 
  {
    myServo.write(i);
    // delay(30);
    distance=calculateDistance(); //calling the calculateDistance() method
    if (distance>100) 
    {
      distance=100;
    }
    Serial.print(i);
    Serial.print(",");
    Serial.print(distance);
    
    Serial.print(".");
    if (distance<40) 
    {
      digitalWrite(led,LOW);
      digitalWrite(buzzer,HIGH);
    }
    else 
    {
      digitalWrite(led,HIGH);
      digitalWrite(buzzer,LOW);
    }
    lcd.clear();
    lcd.print("Angle= ");
    lcd.print(i);
    lcd.print("\337"); 
    lcd.setCursor(0, 1);
    lcd.print("Distance= ");
    lcd.print(distance);
    lcd.print("/cm") ;
    delay(200);
  }
}
// Function for calculating the distance measured by the Ultrasonic sensor
int calculateDistance() 
{
  //1st we're keeping trigPin as LOW for 2 Microseconds
  digitalWrite(trigPin,LOW); 
  delayMicroseconds(2);
  //Then we're doing trigPin as HIGH for 10 Microseconds
  digitalWrite(trigPin,HIGH);
  delayMicroseconds(10);
  //Again we're keeping trigPin as LOW
  digitalWrite(trigPin,LOW);
  //As trigPin is a transmitter so by doing trigPin LOW,HIGH then again LOW a pulse will be generated by trigPin and 
  //as echoPin is a reciever so it'll recieve this pulse and it'll be HIGH
  //now we'll detect this HIGH by using pulseIn() method  
  duration=pulseIn(echoPin,HIGH); // Duration=time(microseconds) taken to recieve the wave by echoPin
//formula: distance=duration*speed of wave/2 //distance(cm)=duration(microseconds)*0.034/2; //distance(inch)=duration(microseconds)*0.0133/2;
  distance=duration*0.034/2; //speed of wave=0.034cm/microseconds=0.0133inch/microseconds
  return distance;
}

